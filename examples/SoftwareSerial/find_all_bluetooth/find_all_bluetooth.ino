//   Данный скетч демонстрирует работу Trema-модуля bluetooth HC-05 в режиме ведущего (master).
//   Модуль ищет имена и адреса всех bluetooth устройств в радиусе действия.
//   Библиотека написана http://iarduino.ru только для Trema-модулей bluetooth HC-05 и не будет работать с другими модулями.
//   ==========================================================================================
     #define pinK 7                          // Любой вывод Arduino который подключается к выводу K модуля (вывод управления режимом команд).
     #define pinRX 8                         // Вывод Arduino RX подключаемый к выводу TX Trema-модуля bluetooth HC-05.
     #define pinTX 9                         // Вывод Arduino TX подключаемый к выводу RX Trema-модуля bluetooth HC-05.

     #include <SoftwareSerial.h>             // Подключаем библиотеку SoftwareSerial, до подключения библиотеки iarduino_Bluetooth_HC05.
     #include <iarduino_Bluetooth_HC05.h>    // Подключаем библиотеку iarduino_Bluetooth_HC05 для работы с модулем.
     SoftwareSerial softSerial(pinRX,pinTX); // Создаём объект softSerial указывая выводы RX, TX (можно указывать любые выводы Arduino UNO)
     iarduino_Bluetooth_HC05 hc05(pinK);     // Создаём объект hc05 указывая вывод Arduino подключённый к выводу K модуля.
     int i;                                  // Объявляем переменную для вывода результатов работы функций.

void setup(){
//   Инициируем передачу данных по аппаратной шине UART для вывода результата в монитор.
     Serial.begin(9600);
//   Инициируем работу с модулем hc05, указывая объект UART через который осуществляется связь.
     i=hc05.begin(softSerial);               // Инициализация модуля может занять несколько секунд.
     Serial.print("begin: "); if(i){Serial.println("Ok");} else {Serial.println("Error");}
}                                        

void loop (){
//   Выполняем поиск устройств, не дольше 10 секунд:
     i=hc05.find(10);
//   Выводим результаты поиска:
     if(i){
         Serial.println((String) "found "+i+" devices:");
         for(int j=0; j<i; j++){
             Serial.print(j+1);
             Serial.print((String) ") Name: "    + hc05.findName[j] );
             Serial.print((String) ", Address: " + hc05.findAddr[j] );
             Serial.println(";");
         }
     }else{  Serial.println("Device not found."); }
//   Ждём 1 секунду
     delay(1000);
}

//   Функция hc05.find(время); возвращает количество найденных устройств, а принимает время в секундах, это таймаут после которого требуется прекратить поиск.
//   Если устройства найдены, то функция затратит еще несколько секунд (свыше таймаута) для их опроса.
//   Все найденные имена устройств сохраняются в массив hc05.findName, а адреса устройств в массив hc05.findAddr.
//   Индексы обоих массивов совпадают, это значит что:
//   - имя 1 устройства находится в hc05.findName[0], а его адрес в hc05.findAddr[0]
//   - имя 2 устройства находится в hc05.findName[1], а его адрес в hc05.findAddr[1]
//   и т.д.
//   Данной функцией можно найти не более 5 устройств. Если до таймаута найдены все 5 устройств, то функция выполнится быстрее таймаута.
